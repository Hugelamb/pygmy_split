## build/right/Kconfig/Kconfig.modules
```kconfig
menu "acpica (C:/Users/Hugh/zmk/modules/lib/acpica)"
osource "$(ZEPHYR_ACPICA_KCONFIG)"
config ZEPHYR_ACPICA_MODULE
	bool
	default y
endmenu
menu "canopennode (C:/Users/Hugh/zmk/modules/lib/canopennode)"
osource "$(ZEPHYR_CANOPENNODE_KCONFIG)"
config ZEPHYR_CANOPENNODE_MODULE
	bool
	default y
endmenu
menu "cmsis (C:/Users/Hugh/zmk/modules/hal/cmsis)"
osource "$(ZEPHYR_CMSIS_KCONFIG)"
config ZEPHYR_CMSIS_MODULE
	bool
	default y
endmenu
menu "cmsis-dsp (C:/Users/Hugh/zmk/modules/lib/cmsis-dsp)"
osource "$(ZEPHYR_CMSIS_DSP_KCONFIG)"
config ZEPHYR_CMSIS_DSP_MODULE
	bool
	default y
endmenu
menu "cmsis-nn (C:/Users/Hugh/zmk/modules/lib/cmsis-nn)"
osource "$(ZEPHYR_CMSIS_NN_KCONFIG)"
config ZEPHYR_CMSIS_NN_MODULE
	bool
	default y
endmenu
menu "fatfs (C:/Users/Hugh/zmk/modules/fs/fatfs)"
osource "$(ZEPHYR_FATFS_KCONFIG)"
config ZEPHYR_FATFS_MODULE
	bool
	default y
endmenu
menu "hal_ambiq (C:/Users/Hugh/zmk/modules/hal/ambiq)"
osource "$(ZEPHYR_HAL_AMBIQ_KCONFIG)"
config ZEPHYR_HAL_AMBIQ_MODULE
	bool
	default y
endmenu
menu "hal_espressif (C:/Users/Hugh/zmk/modules/hal/espressif)"
osource "C:/Users/Hugh/zmk/modules/hal/espressif/zephyr/Kconfig"
config ZEPHYR_HAL_ESPRESSIF_MODULE
	bool
	default y
endmenu
menu "hal_ethos_u (C:/Users/Hugh/zmk/modules/hal/ethos_u)"
osource "$(ZEPHYR_HAL_ETHOS_U_KCONFIG)"
config ZEPHYR_HAL_ETHOS_U_MODULE
	bool
	default y
endmenu
menu "hal_gigadevice (C:/Users/Hugh/zmk/modules/hal/gigadevice)"
osource "$(ZEPHYR_HAL_GIGADEVICE_KCONFIG)"
config ZEPHYR_HAL_GIGADEVICE_MODULE
	bool
	default y
endmenu
menu "hal_nordic (C:/Users/Hugh/zmk/modules/hal/nordic)"
osource "$(ZEPHYR_HAL_NORDIC_KCONFIG)"
config ZEPHYR_HAL_NORDIC_MODULE
	bool
	default y
endmenu
menu "hal_rpi_pico (C:/Users/Hugh/zmk/modules/hal/rpi_pico)"
osource "$(ZEPHYR_HAL_RPI_PICO_KCONFIG)"
config ZEPHYR_HAL_RPI_PICO_MODULE
	bool
	default y
endmenu
menu "hal_telink (C:/Users/Hugh/zmk/modules/hal/telink)"
osource "C:/Users/Hugh/zmk/modules/hal/telink/Kconfig"
config ZEPHYR_HAL_TELINK_MODULE
	bool
	default y
endmenu
menu "liblc3 (C:/Users/Hugh/zmk/modules/lib/liblc3)"
osource "$(ZEPHYR_LIBLC3_KCONFIG)"
config ZEPHYR_LIBLC3_MODULE
	bool
	default y
endmenu
menu "littlefs (C:/Users/Hugh/zmk/modules/fs/littlefs)"
osource "$(ZEPHYR_LITTLEFS_KCONFIG)"
config ZEPHYR_LITTLEFS_MODULE
	bool
	default y
endmenu
menu "lvgl (C:/Users/Hugh/zmk/modules/lib/gui/lvgl)"
osource "C:/Users/Hugh/zmk/modules/lib/gui/lvgl/Kconfig"
config ZEPHYR_LVGL_MODULE
	bool
	default y
endmenu
menu "mbedtls (C:/Users/Hugh/zmk/modules/crypto/mbedtls)"
osource "$(ZEPHYR_MBEDTLS_KCONFIG)"
config ZEPHYR_MBEDTLS_MODULE
	bool
	default y
endmenu
menu "percepio (C:/Users/Hugh/zmk/modules/debug/percepio)"
osource "C:/Users/Hugh/zmk/modules/debug/percepio/zephyr/Kconfig"
config ZEPHYR_PERCEPIO_MODULE
	bool
	default y
endmenu
menu "picolibc (C:/Users/Hugh/zmk/modules/lib/picolibc)"
osource "C:/Users/Hugh/zmk/modules/lib/picolibc/zephyr/Kconfig"
config ZEPHYR_PICOLIBC_MODULE
	bool
	default y
endmenu
menu "segger (C:/Users/Hugh/zmk/modules/debug/segger)"
osource "$(ZEPHYR_SEGGER_KCONFIG)"
config ZEPHYR_SEGGER_MODULE
	bool
	default y
endmenu
menu "trusted-firmware-a (C:/Users/Hugh/zmk/modules/tee/tf-a/trusted-firmware-a)"
osource "$(ZEPHYR_TRUSTED_FIRMWARE_A_KCONFIG)"
config ZEPHYR_TRUSTED_FIRMWARE_A_MODULE
	bool
	default y
endmenu
menu "uoscore-uedhoc (C:/Users/Hugh/zmk/modules/lib/uoscore-uedhoc)"
osource "$(ZEPHYR_UOSCORE_UEDHOC_KCONFIG)"
config ZEPHYR_UOSCORE_UEDHOC_MODULE
	bool
	default y
endmenu
menu "zcbor (C:/Users/Hugh/zmk/modules/lib/zcbor)"
osource "$(ZEPHYR_ZCBOR_KCONFIG)"
config ZEPHYR_ZCBOR_MODULE
	bool
	default y
endmenu
menu "module (C:/Users/Hugh/zmk/app/module)"
osource "C:/Users/Hugh/zmk/app/module/Kconfig"
config ZEPHYR_MODULE_MODULE
	bool
	default y
endmenu
```

## build/right/Kconfig/Kconfig.shield
```kconfig
osource "C:/Users/Hugh/zmk/app/boards/shields/*/Kconfig.shield"
osource "C:\Users\Hugh\pygmy_split\config/boards/shields/*/Kconfig.shield"
```

## build/right/Kconfig/Kconfig.shield.defconfig
```kconfig
osource "C:/Users/Hugh/zmk/app/boards/shields/*/Kconfig.defconfig"
osource "C:\Users\Hugh\pygmy_split\config/boards/shields/*/Kconfig.defconfig"
```

## config/boards/arm/orca/Kconfig.board
```kconfig
# Orca board configuration

# Copyright (c) 2024 Hugh Lam
# SPDX-License-Identifier: MIT

config BOARD_ORCA
	bool "orca"
	depends on SOC_NRF52840_QIAA

config BOARD_ORCA_RIGHT
	bool "orca right"
	depends on SOC_NRF52840_QIAA


config BOARD_ORCA_LEFT
	bool "orca left"
	depends on SOC_NRF52840_QIAA
```

## config/boards/arm/orca/Kconfig.defconfig
```kconfig
if BOARD_ORCA_RIGHT
# define right side as central

config ZMK_SPLIT_BLE_ROLE_CENTRAL
    default y

config ZMK_BLE
	default y

config ZMK_USB
	default y

endif

config ZMK_SPLIT
    default y

config ZMK_KEYBOARD_NAME
    default "orca"

config BOARD
    default "orca"

if USB

config USB_NRFX
    default y

config USB_DEVICE_STACK
    default y
    endif # USB

config BT_CTLR
    default BT

# display definitions

config ZMK_DISPLAY
	select LV_USE_CONT
	select LV_FONT_MONTSERRAT_26

if ZMK_DISPLAY

config SPI
    default y

config LS0XX
    default y

config LV_Z_BITS_PER_PIXEL
    default 1

choice LV_COLOR_DEPTH
    default LV_COLOR_DEPTH_1

endchoice

config LV_DPI_DEF
	default 30

config LV_Z_VDB_SIZE
	default 16

endif # ZMK_DISPLAY
```

## config/boards/arm/pygmy_split/Kconfig.board
```kconfig
# Pygmy board configuration

# Copyright (c) 2024 Hugh Lam
# SPDX-License-Identifier: MIT

config BOARD_PYGMY
	bool "pygmy"
	depends on SOC_NRF52840_QIAA

config BOARD_PYGMY_RIGHT
	bool "pygmy right"
	depends on SOC_NRF52840_QIAA


config BOARD_PYGMY_LEFT
	bool "pygmy left"
	depends on SOC_NRF52840_QIAA
```

## config/boards/arm/pygmy_split/Kconfig.defconfig
```kconfig
if BOARD_PYGMY_LEFT

config ZMK_SPLIT_BLE_ROLE_CENTRAL
    default y

endif

config ZMK_SPLIT
    default y

config ZMK_KEYBOARD_NAME
    default "Pygmy"

if USB

config USB_NRFX
    default y

config USB_DEVICE_STACK
    default y
    endif # USB

config BT_CTLR
    default BT

config ZMK_BLE
	default y

config ZMK_USB
	default y

# display definitions

config ZMK_DISPLAY
	select LV_USE_CONT
	select LV_FONT_MONTSERRAT_26

if ZMK_DISPLAY
    default ZMK_LV_FONT_DEFAULT_SMALL_MONTSERRAT_26

config SPI
    default y

config LS0XX
    default y

config LV_Z_BITS_PER_PIXEL
    default 1

choice LV_COLOR_DEPTH
    default LV_COLOR_DEPTH_1

endchoice

config LV_DPI_DEF
	default 30

config LV_Z_VDB_SIZE
	default 16

endif # ZMK_DISPLAY
```
